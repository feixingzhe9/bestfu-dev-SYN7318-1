/***************************Copyright BestFu 2014-05-14*************************
文	件：	ADC.c
说	明：	STM32F103 ADC外设寄存器配置原文件
编	译：	Keil uVision4 V4.54.0.0
版	本：	v1.0
编	写：	Unarty
日	期：	2015.01.19
修　改：	暂无
*******************************************************************************/
#include "sys.h"
#include "adc.h"
#include "GPIO.h"
		   
/*******************************************************************************
函 数 名：	ADC_Init
功能说明： 	模数转换初始化
参	  数： 	无
返 回 值：	无
注	  意：	指配置的ADC 1通道有效
*******************************************************************************/																   
void ADC_Init(void)
{    	   
	RCC->APB2RSTR |= 1<<9;   //ADC1复位
	RCC->APB2RSTR &= ~(1<<9);//复位结束	    
	
	RCC->APB2ENR |= 1<<9;    //ADC1时钟使能	
	
	GPIOx_Cfg(GPIO_A, pin_1, IN_); 
	
	RCC->CFGR&=~(3<<14);   //分频因子清零	
	//SYSCLK/DIV2=12M ADC时钟设置为12M,ADC最大时钟不能超过14M!
	//否则将导致ADC准确度下降! 
	RCC->CFGR|=2<<14;      	 

	ADC1->CR1 &= 0XF0FFFF;   //工作模式清零
	ADC1->CR1 |= 0<<16;      //独立工作模式  
	ADC1->CR1 &= ~(1<<8);    //非扫描模式	  
	ADC1->CR2 &= ~(1<<1);    //单次转换模式
	ADC1->CR2 &= ~(7<<17);	   
	ADC1->CR2 |= 7<<17;	   //软件控制转换  
	ADC1->CR2 |= 1<<20;      //使用用外部触发(SWSTART)!!!	必须使用一个事件来触发
	ADC1->CR2 &= ~(1<<11);   //右对齐	 
	ADC1->SQR1 &= ~(0XF<<20);
	ADC1->SQR1 &= 0<<20;     //1个转换在规则序列中 也就是只转换规则序列1 			   
	//设置通道0~3的采样时间
	ADC1->SMPR2 &= 0XFFFFF000;//通道0,1,2,3采样时间清空	  
	ADC1->SMPR2 |= 7<<3;      //通道1  239.5周期,提高采样时间可以提高精确度	 

	ADC1->CR2 |= 1<<0;	    //开启AD转换器	 
	ADC1->CR2 |= 1<<3;        //使能复位校准  
	while(ADC1->CR2&1<<3)  //等待校准结束 	
	{}	//该位由软件设置并由硬件清除。在校准寄存器被初始化后该位将被清除。	 
	ADC1->CR2 |= 1<<2;        //开启AD校准	   
	while(ADC1->CR2&1<<2)  //等待校准结束
	{}//该位由软件设置以开始校准，并在校准结束时由硬件清除  
}	


/*******************************************************************************
函 数 名：	ADC_Get
功能说明： 	模数转换结果
参	  数： 	无
返 回 值：	转换结果
注	  意：	ADC 1通道转换结果
*******************************************************************************/
u16 ADC_Get(void)   
{
	//设置转换序列	  		 
	ADC1->SQR3 	&= 0XFFFFFFE0;//规则序列1 通道ch
	ADC1->SQR3 	|= 1;		  			    
	ADC1->CR2 	|= 1<<22;       //启动规则转换通道 
	while(!(ADC1->SR&1<<1))//等待转换结束
	{}
		
	return ADC1->DR;		//返回adc值	
}

/**************************Copyright BestFu 2014-05-14*************************/	
